## main/Kconfig.projbuild
```kconfig
menu "ZH ESP-NOW Sensor Configuration"
	
	config GPIO_RANGE_MAX
		int
		default 16 if IDF_TARGET_ESP8266
		default 33 if IDF_TARGET_ESP32
		default 46 if IDF_TARGET_ESP32S2
		default 48 if IDF_TARGET_ESP32S3
		default 18 if IDF_TARGET_ESP32C2
		default 19 if IDF_TARGET_ESP32C3
		default 30 if IDF_TARGET_ESP32C6

	choice NETWORK_TYPE
		prompt "Network type"
		help
			Network type.
		default NETWORK_TYPE_DIRECT
		config NETWORK_TYPE_DIRECT
			bool "DIRECT"
		config NETWORK_TYPE_MESH
			bool "MESH"
	endchoice
	
	choice SENSOR_TYPE
		prompt "Sensor type"
		default SENSOR_TYPE_N
		config SENSOR_TYPE_N
			bool "N"
		config SENSOR_TYPE_DS18B20
			bool "DS18B20"
		config SENSOR_TYPE_DHT
			bool "DHT"
		config SENSOR_TYPE_AHT
			bool "AHT"
		config SENSOR_TYPE_BH1750
			bool "BH1750"
	endchoice

	choice CONNECTION_TYPE
		depends on SENSOR_TYPE_DS18B20 || SENSOR_TYPE_DHT || SENSOR_TYPE_BH1750 || SENSOR_TYPE_AHT
		prompt "Connection type" 
		default CONNECTION_TYPE_ONEWIRE
		config CONNECTION_TYPE_ONEWIRE
			depends on SENSOR_TYPE_DS18B20 || SENSOR_TYPE_DHT
			bool "ONE WIRE"
		config CONNECTION_TYPE_I2C
			depends on SENSOR_TYPE_DHT || SENSOR_TYPE_BH1750 || SENSOR_TYPE_AHT
			bool "I2C"
	endchoice

	config SENSOR_PIN_1
		depends on CONNECTION_TYPE_ONEWIRE || CONNECTION_TYPE_I2C
		int "Sensor GPIO number (main pin for 1-wire sensors, SDA pin for I2C sensors)"
		range 0 GPIO_RANGE_MAX
		default 5
		help
			Sensor GPIO (main pin for 1-wire sensors, SDA pin for I2C sensors).

	config SENSOR_PIN_2
		depends on CONNECTION_TYPE_I2C
		int "Sensor GPIO number (SCL pin for I2C sensors)"
		range 0 GPIO_RANGE_MAX
		default 14
		help
			Sensor GPIO (SCL pin for I2C sensors).

	config MEASUREMENT_FREQUENCY
		depends on CONNECTION_TYPE_ONEWIRE || CONNECTION_TYPE_I2C
		int "Measurement frequency"
		range 1 65536
		default 300
		help
			Measurement frequency (sleep time on battery power).

	config BATTERY_POWERED
		depends on CONNECTION_TYPE_ONEWIRE || CONNECTION_TYPE_I2C
		bool "Battery powered"
		default false
		help
			Battery powered.

	config POWER_CONTROL_USING
		depends on CONNECTION_TYPE_ONEWIRE
		bool "Enable using sensor power control"
		default true
		help
			Enable using sensor power control (for 1-wire sensors only).

	config POWER_CONTROL_PIN
		depends on POWER_CONTROL_USING
		int "Power control GPIO number"
		range 0 GPIO_RANGE_MAX
		default 12
		help
			Power control GPIO number.

	config POWER_MODE_USING
		bool "Enable power mode selection at startup"
		default true
		help
			Enable power mode selection at startup.

	config POWER_MODE_PIN
		depends on POWER_MODE_USING
		int "Power selection GPIO number"
		range 0 GPIO_RANGE_MAX
		default 1
		help
			Power selection GPIO number.

endmenu 
```

## sdkconfig.defaults
```kconfig
CONFIG_LOG_BOOTLOADER_LEVEL_NONE=y
CONFIG_LOG_BOOTLOADER_LEVEL=0

CONFIG_ESPTOOLPY_FLASHMODE_DOUT=y
CONFIG_ESPTOOLPY_FLASHMODE="dout"
CONFIG_SPI_FLASH_MODE=0x3

CONFIG_ESPTOOLPY_FLASHSIZE_1MB=y
CONFIG_ESPTOOLPY_FLASHSIZE="1MB"
CONFIG_SPI_FLASH_SIZE=0x100000

CONFIG_PARTITION_TABLE_CUSTOM=y
CONFIG_PARTITION_TABLE_FILENAME="partitions.csv"

CONFIG_COMPILER_OPTIMIZATION_LEVEL_RELEASE=y

CONFIG_ESP8266_DEFAULT_CPU_FREQ_80=y
CONFIG_ESP8266_DEFAULT_CPU_FREQ_MHZ=80

CONFIG_ESP_PANIC_SILENT_REBOOT=y

CONFIG_LOG_DEFAULT_LEVEL_NONE=y
CONFIG_LOG_DEFAULT_LEVEL=0
```
